

#include "U8glib.h"
#include <String.h>
#include  <SoftwareSerial.h>
#include <AltSoftSerial.h>
AltSoftSerial QRSerial;
//SoftwareSerial QRSerial(8,9); // RX 、 TX
unsigned long curtime=0;
int interval =3000; 
char disp[4];
U8GLIB_ST7920_128X64_4X u8g(13, 11, 10);  // SPI Com: SCK = en = 18, MOSI = rw = 16, CS = di = 17
int scan=0;
const unsigned char bitmap_zero[] PROGMEM = {
  0x00,0x00, // ................
  0x00,0x00, // ................
  0x00,0x00, // ................
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  0x00,0x00  // ................
};


const unsigned char bitmap_one[] PROGMEM = {
  0x00,0x00, // ................
  0x00,0x00, // ................
  0x00,0x00, // ................
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  0x00,0x00  // ................
};

const unsigned char bitmap_two[] PROGMEM = {
  0x00,0x00, // ................
  0x00,0x00, // ................
  0x00,0x00, // ................
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  0x00,0x00  // ................
};

const unsigned char bitmap_three[] PROGMEM = {
  0x00,0x00, // ................
  0x00,0x00, // ................
  0x00,0x00, // ................
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  0x00,0x00  // ................
};

const unsigned char bitmap_four[] PROGMEM = {
  0x00,0x00, // ................
  0x00,0x00, // ................
  0x00,0x00, // ................
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  0x00,0x00  // ................
};

const unsigned char bitmap_five[] PROGMEM = {
  0x00,0x00, // ................
  0x00,0x00, // ................
  0x00,0x00, // ................
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  0x00,0x00  // ................
};

const unsigned char bitmap_six[] PROGMEM = {
  0x00,0x00, // ................
  0x00,0x00, // ................
  0x00,0x00, // ................
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  0x00,0x00  // ................
};

const unsigned char bitmap_seven[] PROGMEM = {
  0x00,0x00, // ................
  0x00,0x00, // ................
  0x00,0x00, // ................
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  0x00,0x00  // ................
};

const unsigned char bitmap_eight[] PROGMEM = {
  0x00,0x00, // ................
  0x00,0x00, // ................
  0x00,0x00, // ................
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  0x00,0x00  // ................
};

const unsigned char bitmap_nine[] PROGMEM = {
  0x00,0x00, // ................
  0x00,0x00, // ................
  0x00,0x00, // ................
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  0x00,0x00  // ................
};


const unsigned char bitmap_sharp[] PROGMEM = {
  0x00,0x00, // ................
  0x00,0x00, // ................
  0x00,0x00, // ................
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  0x00,0x00  // ................
};


const unsigned char bitmap_check[] PROGMEM = {
  0x00,0x00,0x00, // ........................
  0x00,0x00,0x00, // ........................
  0x00,0x7E,0x00, // .........######.........
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  0x00,0x00,0x00  // ........................
};

const unsigned char bitmap_text[] PROGMEM = {
  0x00,0x00,0x00,0x00,0x00,0x00,0x00,0x00,0x00,0x00,0x00,0x00,0x00,0x00,0x00,0x00, // ................................................................................................................................
  0x00,0x00,0x00,0x00,0x00,0x00,0x00,0x00,0x00,0x00,0x00,0x00,0x00,0x00,0x00,0x00, // ................................................................................................................................
  0x03,0xC0,0xFF,0xF0,0x00,0x3F,0xFF,0xFC,0x00,0x00,0xF0,0xF0,0x00,0x00,0x0F,0x00, // ......####......############..............####################..................####....####........................####........
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  0x00,0x00,0x00,0x00,0x00,0x00,0x3F,0xFC,0x00,0x00,0x00,0x00,0x00,0x00,0x00,0x00  // ..................................................############..................................................................
};

const unsigned char bitmap_error[] PROGMEM = {
  0x00,0x00,0x00,0x00,0x00,0x00,0x00,0x00,0x00,0x00,0x00,0x00,0x00,0x00,0x00,0x00, // ................................................................................................................................
  0x00,0x00,0x00,0x00,0x00,0x00,0x00,0x00,0x00,0x00,0x00,0x00,0x00,0x00,0x00,0x00, // ................................................................................................................................
  0x00,0x00,0x00,0x00,0x00,0x00,0x00,0x00,0x00,0x00,0x00,0x00,0x00,0x00,0x00,0x00, // ................................................................................................................................
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  0x00,0x00,0x00,0x00,0x00,0x00,0x00,0x00,0x00,0x00,0x00,0x00,0x00,0x00,0x00,0x00  // ................................................................................................................................
};

void drawURL(void)
{
  u8g.setFont(u8g_font_gdr12);
  
  u8g.drawStr(60,30,"1236");
  
}
void drawOne(void)
{
  u8g.drawBitmapP( 40, 2, 2, 24, bitmap_zero);
  
}
void draw(void) {
  
  if(scan==1)
  {
    
    // graphic commands to redraw the complete screen should be placed here  
  u8g.drawBitmapP( 0, 2, 3, 24, bitmap_check);
  u8g.drawBitmapP( 24, 2, 2, 24, bitmap_sharp);
  switch(disp[0]){
    case '0': u8g.drawBitmapP( 40, 2, 2, 24, bitmap_zero);break;
    case '1': u8g.drawBitmapP( 40, 2, 2, 24, bitmap_one); break;
    case '2': u8g.drawBitmapP( 40, 2, 2, 24, bitmap_two); break;
    case '3': u8g.drawBitmapP( 40, 2, 2, 24, bitmap_three); break;
    case '4': u8g.drawBitmapP( 40, 2, 2, 24, bitmap_four); break;
    case '5': u8g.drawBitmapP( 40, 2, 2, 24, bitmap_five); break;
    case '6': u8g.drawBitmapP( 40, 2, 2, 24, bitmap_six); break;
    case '7': u8g.drawBitmapP( 40, 2, 2, 24, bitmap_seven); break;
    case '8': u8g.drawBitmapP( 40, 2, 2, 24, bitmap_eight); break;
    case '9': u8g.drawBitmapP( 40, 2, 2, 24, bitmap_nine); break;
    default:drawOne;
  }
  switch(disp[1]){
    case '0': u8g.drawBitmapP( 56, 2, 2, 24, bitmap_zero);break;
    case '1': u8g.drawBitmapP( 56, 2, 2, 24, bitmap_one); break;
    case '2': u8g.drawBitmapP( 56, 2, 2, 24, bitmap_two); break;
    case '3': u8g.drawBitmapP( 56, 2, 2, 24, bitmap_three); break;
    case '4': u8g.drawBitmapP( 56, 2, 2, 24, bitmap_four); break;
    case '5': u8g.drawBitmapP( 56, 2, 2, 24, bitmap_five); break;
    case '6': u8g.drawBitmapP( 56, 2, 2, 24, bitmap_six); break;
    case '7': u8g.drawBitmapP( 56, 2, 2, 24, bitmap_seven); break;
    case '8': u8g.drawBitmapP( 56, 2, 2, 24, bitmap_eight); break;
    case '9': u8g.drawBitmapP( 56, 2, 2, 24, bitmap_nine); break;
  }
  switch(disp[2]){
    case '0': u8g.drawBitmapP( 72, 2, 2, 24, bitmap_zero);break;
    case '1': u8g.drawBitmapP( 72, 2, 2, 24, bitmap_one); break;
    case '2': u8g.drawBitmapP( 72, 2, 2, 24, bitmap_two); break;
    case '3': u8g.drawBitmapP( 72, 2, 2, 24, bitmap_three); break;
    case '4': u8g.drawBitmapP( 72, 2, 2, 24, bitmap_four); break;
    case '5': u8g.drawBitmapP( 72, 2, 2, 24, bitmap_five); break;
    case '6': u8g.drawBitmapP( 72, 2, 2, 24, bitmap_six); break;
    case '7': u8g.drawBitmapP( 72, 2, 2, 24, bitmap_seven); break;
    case '8': u8g.drawBitmapP( 72, 2, 2, 24, bitmap_eight); break;
    case '9': u8g.drawBitmapP( 72, 2, 2, 24, bitmap_nine); break;
  }
  switch(disp[3]){
    case '0': u8g.drawBitmapP( 88, 2, 2, 24, bitmap_zero);break;
    case '1': u8g.drawBitmapP( 88, 2, 2, 24, bitmap_one); break;
    case '2': u8g.drawBitmapP( 88, 2, 2, 24, bitmap_two); break;
    case '3': u8g.drawBitmapP( 88, 2, 2, 24, bitmap_three); break;
    case '4': u8g.drawBitmapP( 88, 2, 2, 24, bitmap_four); break;
    case '5': u8g.drawBitmapP( 88, 2, 2, 24, bitmap_five); break;
    case '6': u8g.drawBitmapP( 88, 2, 2, 24, bitmap_six); break;
    case '7': u8g.drawBitmapP( 88, 2, 2, 24, bitmap_seven); break;
    case '8': u8g.drawBitmapP( 88, 2, 2, 24, bitmap_eight); break;
    case '9': u8g.drawBitmapP( 88, 2, 2, 24, bitmap_nine); break;
  }
  u8g.drawBitmapP( 104, 2, 3, 24, bitmap_check);
  u8g.drawBitmapP( 0, 30, 16, 32, bitmap_text);
  
  }
 
}

void setup(void) {
  Serial.begin(9600);
  QRSerial.begin(57600);
}

void loop(void) {
  
  // picture loop
  char c=' ';
  String data="";
  u8g.firstPage();  
  do {
    draw();
    //drawURL();
  } while( u8g.nextPage() );
  
  while(QRSerial.available())
{
  c=QRSerial.read();
  Serial.write(c);
  data+=c;
  if(!QRSerial.available())
    Serial.println();
   

}
if(data!="\0")
{
  scan=1;
  curtime=millis();
 // Serial.println(data);
 // Serial.println(data.length());
char datachar[data.length()+1];
data.toCharArray(datachar,data.length()+1);
for(int i=25;datachar[i]!='\0';i++)
{
//Serial.print(datachar[i]); // 25-28
disp[i-25]=datachar[i];
//Serial.print(disp[i-25]); // 25-28
//Serial.println();
}
  // rebuild the picture after some delay
  
}
if(millis()-curtime>interval)
{
  if(scan==1)
  scan=0;
}
}
